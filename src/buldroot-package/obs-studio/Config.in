## src/buldroot-package/obs-studio/Config.in
```kconfig
config BR2_PACKAGE_OBS_STUDIO
    bool "obs-studio"
    depends on BR2_x86_64
    depends on BR2_PACKAGE_XORG7
    help
      Video recording and live streaming.

	    https://obsproject.com/
```

## src/buldroot-package/obs-studio/cef/Config.in
```kconfig
config BR2_PACKAGE_CEF
    bool "cef"
    depends on BR2_x86_64
    help
      Chromium Embedded Framework.
```

## src/buldroot-package/popstationr/Config.in
```kconfig
config BR2_PACKAGE_POPSTATIONR
	bool "popstationr"
	help
	  convert psp-psx .pbp to .iso
```

## src/buldroot-package/preload/Config.in
```kconfig
config BR2_PACKAGE_PRELOAD
	bool "preload"
	help
	  Makes applications run faster by prefetching binaries and shared objects.
```

## src/buldroot-package/tint2/Config.in
```kconfig
config BR2_PACKAGE_TINT2
    bool "tint2"
    help
      tint2 - lightweight panel/taskbar

      https://gitlab.com/o9000/tint2/tree/master
```

## src/buldroot-package/vkbasalt/Config.in
```kconfig
config BR2_PACKAGE_VKBASALT
	bool "vkbasalt"
	depends on BR2_PACKAGE_LIBDRM
        depends on BR2_PACKAGE_XORG7
	depends on BR2_PACKAGE_VULKAN_HEADERS
	help
	  A vulkan post processing layer for linux.

          https://github.com/DadSchoorse/vkBasalt
```
