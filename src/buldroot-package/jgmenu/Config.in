## src/buldroot-package/libretro-beetle-pce-full/Config.in
```kconfig
config BR2_PACKAGE_LIBRETRO_BEETLE_PCE_FULL
        bool "libretro-beetle-pce-full"
	depends on BR2_PACKAGE_RETROARCH
	depends on BR2_INSTALL_LIBSTDCPP
        help
          A libretro PCE emulator core for ARM.

	  http://www.libretro.com

comment "LIBRETRO_BEETLE_PCE_FULL needs a toolchain w/ C++"
	depends on !BR2_INSTALL_LIBSTDCPP
```

## src/buldroot-package/libretro-blastem/Config.in
```kconfig
config BR2_PACKAGE_LIBRETRO_BLASTEM
        bool "libretro-bsnes"
	depends on BR2_PACKAGE_RETROARCH
	depends on BR2_INSTALL_LIBSTDCPP
        help
          A libretro Mega Drive emulator core.

	  http://www.libretro.com

comment "LIBRETRO_BLASTEM needs a toolchain w/ C++"
	depends on !BR2_INSTALL_LIBSTDCPP
```

## src/buldroot-package/libretro-crocods/Config.in
```kconfig
config BR2_PACKAGE_LIBRETRO_CROCODS
	bool "libretro-crocods"
	depends on BR2_PACKAGE_RETROARCH
	depends on BR2_INSTALL_LIBSTDCPP
        help
          A libretro NDS emulator core.

	  http://www.libretro.com

comment "LIBRETRO_CROCODS needs a toolchain w/ C++"
	depends on !BR2_INSTALL_LIBSTDCPP
```

## src/buldroot-package/libretro-duckstation/Config.in
```kconfig
config BR2_PACKAGE_LIBRETRO_DUCKSTATION
	bool "libretro-dolphin"
	depends on BR2_PACKAGE_RETROARCH
	depends on BR2_INSTALL_LIBSTDCPP
	help
          A libretro psx emulator core.

	  http://www.libretro.com

comment "LIBRETRO_DUCKSTATION needs a toolchain w/ C++"
	depends on !BR2_INSTALL_LIBSTDCPP
```

## src/buldroot-package/libretro-easyrpg-liblcf/Config.in
```kconfig
config BR2_PACKAGE_LIBRETRO_EASYRPG_LIBLCF
	bool "libretro-easyrpg-liblcf"
	select BR2_PACKAGE_ICU
	help
	  Library to handle RPG Maker 2000 and 2003 game data.

	  https://github.com/EasyRPG/liblcf
```

## src/buldroot-package/libretro-easyrpg-player/Config.in
```kconfig
config BR2_PACKAGE_LIBRETRO_PLAYER_EASYRPG
	bool "libretro-easyrpg-player"
	depends on BR2_PACKAGE_RETROARCH
	depends on BR2_INSTALL_LIBSTDCPP
	select BR2_PACKAGE_LIBRETRO_EASYRPG_LIBLCF

    help
      A libretro EasyRPG game engine.

	  https://github.com/EasyRPG/Player

comment "LIBRETRO_EASYRPG needs a toolchain w/ C++"
	depends on !BR2_INSTALL_LIBSTDCPP
```

## src/buldroot-package/libretro-emuscv/Config.in
```kconfig
config BR2_PACKAGE_LIBRETRO_EMUSCV
	bool "libretro-emuscv"
	depends on BR2_PACKAGE_RETROARCH
	depends on BR2_INSTALL_LIBSTDCPP
	help
	  A libretro Super Cassette Vision emulator core for ARM.

	  http://www.libretro.com

comment "LIBRETRO_VECX needs a toolchain w/ C++"
	depends on !BR2_INSTALL_LIBSTDCPP
```

## src/buldroot-package/libretro-fbalpha2012-cps1/Config.in
```kconfig
config BR2_PACKAGE_LIBRETRO_FBALPHA2012_CPS1
        bool "libretro-fbalpha2012-cps1"
	depends on BR2_PACKAGE_RETROARCH
	depends on BR2_INSTALL_LIBSTDCPP
        help
          A libretro FBA core.

	  http://www.libretro.com

comment "LIBRETRO_FBALPHA2012_CPS1 needs a toolchain w/ C++"
	depends on !BR2_INSTALL_LIBSTDCPP
```

## src/buldroot-package/libretro-fbalpha2012-cps2/Config.in
```kconfig
config BR2_PACKAGE_LIBRETRO_FBALPHA2012_CPS2
        bool "libretro-fbalpha2012-cps2"
	depends on BR2_PACKAGE_RETROARCH
	depends on BR2_INSTALL_LIBSTDCPP
        help
          A libretro FBA core.

	  http://www.libretro.com

comment "LIBRETRO_FBALPHA2012_CPS2 needs a toolchain w/ C++"
	depends on !BR2_INSTALL_LIBSTDCPP
```

## src/buldroot-package/libretro-fbalpha2012-neogeo/Config.in
```kconfig
config BR2_PACKAGE_LIBRETRO_FBALPHA2012_NEOGEO
        bool "libretro-fbalpha2012-neogeo"
	depends on BR2_PACKAGE_RETROARCH
	depends on BR2_INSTALL_LIBSTDCPP
        help
          A libretro FBA core.

	  http://www.libretro.com

comment "LIBRETRO_FBALPHA2012_NEOGEO needs a toolchain w/ C++"
	depends on !BR2_INSTALL_LIBSTDCPP
```

## src/buldroot-package/libretro-flycast2019/Config.in
```kconfig
config BR2_PACKAGE_LIBRETRO_FLYCAST2019
        bool "libretro-flycast2019"
	depends on BR2_PACKAGE_RETROARCH
	depends on BR2_INSTALL_LIBSTDCPP
        help
          A libretro dreamcast emulator core.

	  http://www.libretro.com

comment "LIBRETRO_FLYCAST2019 needs a toolchain w/ C++"
	depends on !BR2_INSTALL_LIBSTDCPP
```

## src/buldroot-package/libretro-gearsystem/Config.in
```kconfig
config BR2_PACKAGE_LIBRETRO_GEARSYSTEM
        bool "libretro-gearsystem"
	depends on BR2_PACKAGE_RETROARCH
        help
          A libretro Game Gear Emulator core.

	  http://www.libretro.com

comment "LIBRETRO_GEARSYSTEM needs a toolchain w/ C++"
	depends on !BR2_INSTALL_LIBSTDCPP
```

## src/buldroot-package/libretro-mame2000/Config.in
```kconfig
config BR2_PACKAGE_LIBRETRO_MAME2000
        bool "libretro-mame2000"
	depends on BR2_PACKAGE_RETROARCH
	depends on BR2_INSTALL_LIBSTDCPP
        help
          A libretro mame2000 core for ARM.

	  http://www.libretro.com

comment "LIBRETRO_MAME2000 needs a toolchain w/ C++"
	depends on !BR2_INSTALL_LIBSTDCPP
```

## src/buldroot-package/libretro-mame2018/Config.in
```kconfig
config BR2_PACKAGE_LIBRETRO_MAME2018
        bool "libretro-mame2018"
	depends on BR2_PACKAGE_RETROARCH
	depends on BR2_INSTALL_LIBSTDCPP
        help
          A libretro mame core.

	  http://www.libretro.com

comment "LIBRETRO_MAME needs a toolchain w/ C++"
	depends on !BR2_INSTALL_LIBSTDCPP
```

## src/buldroot-package/libretro-melonds/Config.in
```kconfig
config BR2_PACKAGE_LIBRETRO_MELONDS
        bool "libretro-melonds"
	depends on BR2_PACKAGE_RETROARCH
        help
          A libretro Nintendo DS core.

	  http://www.libretro.com

comment "LIBRETRO_MELONDS needs a toolchain w/ C++"
	depends on !BR2_INSTALL_LIBSTDCPP
```

## src/buldroot-package/libretro-mess/Config.in
```kconfig
config BR2_PACKAGE_LIBRETRO_MESS
        bool "libretro-mess"
	depends on BR2_PACKAGE_RETROARCH
	depends on BR2_INSTALL_LIBSTDCPP
        help
          A libretro mame core for Mess.

	  http://www.libretro.com

comment "LIBRETRO_MESS needs a toolchain w/ C++"
	depends on !BR2_INSTALL_LIBSTDCPP
```

## src/buldroot-package/libretro-nekop2/Config.in
```kconfig
config BR2_PACKAGE_LIBRETRO_NEKOP2
        bool "libretro-nekop2"
	depends on BR2_PACKAGE_RETROARCH
	depends on BR2_INSTALL_LIBSTDCPP
        help
          A libretro PC98 emulator core.

	  http://www.libretro.com

comment "LIBRETRO_NEKOP2 needs a toolchain w/ C++"
	depends on !BR2_INSTALL_LIBSTDCPP
```

## src/buldroot-package/libretro-np2kai/Config.in
```kconfig
config BR2_PACKAGE_LIBRETRO_NP2KAI
        bool "libretro-np2kai"
	depends on BR2_PACKAGE_RETROARCH
        help
          A libretro Nec PC98 core.

	  http://www.libretro.com

comment "LIBRETRO_NP2KAI needs a toolchain w/ C++"
	depends on !BR2_INSTALL_LIBSTDCPP
```

## src/buldroot-package/libretro-play/Config.in
```kconfig
config BR2_PACKAGE_LIBRETRO_PLAY
	bool "libretro-play"
	depends on BR2_PACKAGE_RETROARCH
	depends on BR2_INSTALL_LIBSTDCPP
	help
          A libretro PS2 emulator core.

comment "LIBRETRO_PLAY needs a toolchain w/ C++"
	depends on !BR2_INSTALL_LIBSTDCPP
```

## src/buldroot-package/libretro-race/Config.in
```kconfig
config BR2_PACKAGE_LIBRETRO_RACE
        bool "libretro-race"
	depends on BR2_PACKAGE_RETROARCH
        help
          A libretro Neogeo Pocket core.

	  http://www.libretro.com

comment "LIBRETRO_RACE needs a toolchain w/ C++"
	depends on !BR2_INSTALL_LIBSTDCPP
```

## src/buldroot-package/libretro-simcoupe/Config.in
```kconfig
config BR2_PACKAGE_LIBRETRO_SIMCOUPE
        bool "libretro-simcoupe"
	depends on BR2_PACKAGE_RETROARCH
	depends on BR2_INSTALL_LIBSTDCPP
        help
          A SimCoupe core for Retroarch

	  http://www.libretro.com

comment "LIBRETRO_SIMCOUPE needs a toolchain w/ C++"
	depends on !BR2_INSTALL_LIBSTDCPP
```

## src/buldroot-package/libretro-smsplus-gx/Config.in
```kconfig
config BR2_PACKAGE_LIBRETRO_SMSPLUS_GX
        bool "libretro-smsplus-gx"
	depends on BR2_PACKAGE_RETROARCH
	depends on BR2_INSTALL_LIBSTDCPP
        help
          A libretro SEGA 8 bits emulator core for Retroarch.

	  http://www.libretro.com

comment "LIBRETRO_SMSPLUS_GX needs a toolchain w/ C++"
	depends on !BR2_INSTALL_LIBSTDCPP
```

## src/buldroot-package/libretro-uzem/Config.in
```kconfig
config BR2_PACKAGE_LIBRETRO_UZEM
	bool "libretro-uzem"
	depends on BR2_PACKAGE_RETROARCH
	depends on BR2_INSTALL_LIBSTDCPP
	help
	  A libretro Uzebox emulator core.

	  http://www.libretro.com

comment "LIBRETRO_UZEM needs a toolchain w/ C++"
	depends on !BR2_INSTALL_LIBSTDCPP
```

## src/buldroot-package/nsxiv/Config.in
```kconfig
config BR2_PACKAGE_NSXIV
        bool "nsxiv"

        help
          A image viewer.
```
